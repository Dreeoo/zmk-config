## config/west.yml
```yaml
manifest:
  remotes:
    - name: zmkfirmware
      url-base: https://github.com/zmkfirmware
  projects:
    - name: zmk
      remote: zmkfirmware
      revision: 64daf698e073e37b6748ac54f4eb48d8666af0b9
      import: app/west.yml
    - name: zmk_driver_azoteq
      url: https://github.com/Dreeoo/zmk_driver_azoteq
      revision: ba92125104af561e90da4c44891f92c725fdb190
  self:
    path: config
```
